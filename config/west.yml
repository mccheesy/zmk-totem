## config/west.yml
```yaml
manifest:
  remotes:
    - name: zmkfirmware
      url-base: https://github.com/zmkfirmware
    - name: mccheesy
      url-base: https://github.com/mccheesy
    - name: urob
      url-base: https://github.com/urob

  projects:
    - name: zmk
      remote: zmkfirmware
      import: app/west.yml
      revision: main

    - name: zmk-keyboard-totem
      remote: mccheesy
      revision: main

    - name: zmk-adaptive-key
      remote: urob
      revision: main

    - name: zmk-auto-layer
      remote: urob
      revision: main

    - name: zmk-helpers
      remote: urob
      revision: main

    - name: zmk-tri-state
      remote: urob
      revision: main

  self:
    path: config
```
