#include <behaviors.dtsi>
#include <behaviors/num_word.dtsi> // requires https://github.com/urob/zmk-auto-layer module
#include <zmk-helpers/helper.h>
#include <dt-bindings/zmk/keys.h>

#ifdef CONFIG_WIRELESS
	#include <dt-bindings/zmk/bt.h>
	#include <dt-bindings/zmk/outputs.h>
#endif

#define BASE 0
#define QWRT 1
#define GAME 2
#define EMAG 3
#define NUM  4
#define FUN  5

#define XXX &none
#define ___ &trans

/* Global Defaults */

// Behaviors
#define TAPPING_TERM_MS 280
#define QUICK_TAP_MS 175
#define REQUIRE_PRIOR_IDLE_MS 150

// Combos
#define COMBO_TERM_DEFAULT 30
#define COMBO_QUICK_TAP_MS 100

#include "behaviors.dtsi"
#include "macros.dtsi"
#include "combos.dtsi"

#define _LEFT_THUMBS_  &mt LALT ESC  &mt LCTRL SPACE &mt LSHFT TAB
#define _RIGHT_THUMBS_ &mt RSHFT RET &mbsp RCTRL 0   GRAVE_TILDE

#include "colemak-dh.dtsi"              // BASE
#include "qwerty.dtsi"					// QWRT
#include "qwerty_no_hrm.dtsi"			// GAME
#include "qwerty_no_hrm_mirrored.dtsi"  // EMAG
#include "num.dtsi"						// NUM
#include "fun.dtsi"						// FUN
