// ZMK Behaviors Configuration
&lt {
    flavor = "balanced";
    tapping-term-ms = <TAPPING_TERM_MS>;
    quick-tap-ms = <QUICK_TAP_MS>;
    require-prior-idle-ms = <REQUIRE_PRIOR_IDLE_MS>;
};

&mt {
    flavor = "balanced";
    tapping-term-ms = <TAPPING_TERM_MS>;
    quick-tap-ms = <QUICK_TAP_MS>;
    require-prior-idle-ms = <REQUIRE_PRIOR_IDLE_MS>;
};

&sk {
	release-after-ms = <900>;
    quick-release;
};

&sl { // Allow sticky mods to chord across sticky layers
	ignore-modifiers;
};

/* Homerow mods */
#define MAKE_HRM(NAME, HOLD, TAP, TRIGGER_POS)                                 \
	ZMK_HOLD_TAP(NAME, bindings = <HOLD>, <TAP>; flavor = "balanced";          \
				 tapping-term-ms = <TAPPING_TERM_MS>;                          \
				 quick-tap-ms = <QUICK_TAP_MS>;                                \
				 require-prior-idle-ms = <REQUIRE_PRIOR_IDLE_MS>;              \
				 hold-trigger-on-release;                                      \
				 hold-trigger-key-positions = <TRIGGER_POS>;)

MAKE_HRM(hml, &kp, &kp, KEYS_R THUMBS) // Left-hand mods
MAKE_HRM(hmr, &kp, &kp, KEYS_L THUMBS) // Right-hand mods
MAKE_HRM(hll, &mo, &kp, KEYS_R THUMBS) // Left-hand layers
MAKE_HRM(hlr, &mo, &kp, KEYS_L THUMBS) // Right-hand layers

/* Magic-shift & auto-layers */
// Tap: repeat after alpha, else sticky-shift
// Shift + tap/ double-tap: caps-word | Hold: shift.
#define MAGIC_SHIFT &magic_shift LSHFT 0
ZMK_HOLD_TAP(magic_shift, bindings = <&kp>, <&magic_shift_tap>;
			 flavor = "balanced"; tapping-term-ms = <200>;
			 quick-tap-ms = <QUICK_TAP_MS>;)
ZMK_MOD_MORPH(magic_shift_tap, bindings = <&shift_repeat>, <&caps_word>;
			  mods = <(MOD_LSFT)>;)
ZMK_ADAPTIVE_KEY(
	shift_repeat, bindings = <&sk LSHFT>;
	repeat {
		trigger-keys = <A B C D E F G H I J K L M N O P Q R S T U V W X Y Z>;
		bindings = <&key_repeat>;
		max-prior-idle-ms = <1200>;
		strict-modifiers;
	};)
&caps_word { // Adds bypasses for const definitions
    /delete-property/ ignore-modifiers;
    /delete-property/ ignore-numbers;

    continue-list = <MINUS UNDER>;
};

// Tap: num-word | Double-tap: sticky num-layer | Hold: num-layer
ZMK_HOLD_TAP(smart_num, bindings = <&mo>, <&num_dance>; flavor = "balanced";
				 tapping-term-ms = <200>;
				 quick-tap-ms = <QUICK_TAP_MS>;) 
ZMK_TAP_DANCE(num_dance, bindings = <&num_word NUM>, <&sl NUM>;
			  tapping-term-ms = <200>;)
&num_word { // Adds arrows and shift for more comfortable navigation/selection moves
    continue-list = <BSPC DEL DOT COMMA PLUS MINUS STAR FSLH EQUAL LSHFT RSHFT LEFT RIGHT UP DOWN>;
};

/* Custom behaviors */
// Alt+Tab swapper, requires tri-state module.
// Stolen from https://github.com/urob/zmk-config
ZMK_TRI_STATE(swapper, bindings = <&kt LALT>, <&kp TAB>, <&kt LALT>;
			  ignored-key-positions = <RM0 RM1 RM2 RM3 RB0 RB3>;)

// Autoshift behavior implemented using C preprocessor and ZMK hold-tap
// Tap: &kp | Shift+Tap: &sh | Hold: &sh
ZMK_HOLD_TAP(autoshift, bindings = <&kp>, <&kp>; flavor = "tap-preferred";
			 tapping-term-ms = <150>; quick-tap-ms = <200>;
			 require-prior-idle-ms = <125>;)
#define AS(KEY) &autoshift LS(KEY) KEY

// Autoshift-morphs
// Tap: &kp TAP | Shift+tap: &kp HOLD | Hold: &kp HOLD
// Allows for auto-shift (hold-shift) behavior on shift morphs
// i.e. ,/? | .! | :: | 1/| | 9+ | 0= etc
#define COLON_SEMI  &autoshift SEMI  COLON
#define COMMA_QMARK &autoshift QMARK COMMA
#define DOT_EXCL    &autoshift EXCL  DOT
#define GRAVE_TILDE &autoshift TILDE GRAVE
#define N1_PIPE     &autoshift PIPE  N1
#define N9_PLUS     &autoshift PLUS  N9
#define N0_EQUAL    &autoshift EQUAL N0

// Define mod-morph with a *single* mod trigger for less repetition.
#define SIMPLE_MORPH(NAME, MOD, BINDING1, BINDING2)                            \
	ZMK_MOD_MORPH(NAME, mods = <(MOD_L##MOD | MOD_R##MOD)>;                    \
				  bindings = <BINDING1>, <BINDING2>;)

// Tap: backspace | Shift+tap: delete
SIMPLE_MORPH(bkspc_del, SFT, &kp BSPC, &kp DEL)
ZMK_HOLD_TAP(mbsp, bindings = <&kp>, <&bkspc_del>; flavor = "balanced";
		     tapping-term-ms = <200>;)

// Tap: bootloader | Hold: reboot
ZMK_HOLD_TAP(rst_boot, bindings = <&bootloader>, <&sys_reset>;
			 flavor = "tap-preferred"; tapping-term-ms = <500>;)

// Tap: volume down | Shift+tap: mute
SIMPLE_MORPH(vol_dn_mute, SFT, &kp C_VOL_DN, &kp C_MUTE)
